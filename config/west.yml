## config/west.yml
```yaml
# DYA 版: cormoran さんの ZMK（main の線、custom studio protocol）。DYA Studio で同時押し・マクロを画面から編集できる
# シールド定義は取り込むだけ（シールド定義の west.yml の ZMK の指定＝公式 main は使わない）
manifest:
  remotes:
    - name: cormoran
      url-base: https://github.com/cormoran
    - name: nazuna293
      url-base: https://github.com/nazuna293
    - name: kot149
      url-base: https://github.com/kot149
    - name: caksoylar
      url-base: https://github.com/caksoylar
  projects:
    - name: zmk
      remote: cormoran
      revision: 1fc72aaff7a42bd533c1f4c9b3f23c5317c745f4 # main+custom-studio-protocol（2026-07-22）
      import: app/west.yml
    - name: zmk-feature-runtime-combo # DYA Studio で同時押しを編集（zmk-feature-custom-settings も取り込む）
      remote: cormoran
      revision: d9490e7b5d41c516221d131241009e81740efcee
      import: true
    - name: zmk-feature-runtime-macro # DYA Studio でマクロを作る（キーには &rmacro 番号 を割り当てる）
      remote: cormoran
      revision: 38530962eb7061b60efcb98e84585cfb1f0cb6de
      import: true
    - name: zmk-keyboard-Enigma_01
      remote: nazuna293
      revision: zmk-main
    - name: zmk-layout-shift
      remote: kot149
      revision: v2
    - name: zmk-rgbled-widget
      remote: caksoylar
      revision: main
  self:
    path: config
```
