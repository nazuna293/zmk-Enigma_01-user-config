## config/west.yml
```yaml
manifest:
  remotes:
    - name: nazuna293
      url-base: https://github.com/nazuna293
  projects:
    - name: zmk-keyboard-Enigma_01
      remote: nazuna293
      revision: no-interrupt
      import: config/west.yml
  self:
    path: config
```
